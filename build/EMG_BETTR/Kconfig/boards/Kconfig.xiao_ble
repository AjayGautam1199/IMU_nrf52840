## build/EMG_BETTR/Kconfig/boards/Kconfig.xiao_ble
```kconfig
# Load board Kconfig descriptions.
osource "/opt/nordic/ncs/v3.2.2/zephyr/boards/seeed/xiao_ble/Kconfig.xiao_ble"
```

## build/Kconfig/boards/Kconfig.defconfig
```kconfig
# Load Zephyr board defconfig descriptions.
osource "/opt/nordic/ncs/v3.2.2/zephyr/boards/seeed/xiao_ble/Kconfig.defconfig"
```

## build/Kconfig/boards/Kconfig.sysbuild
```kconfig
# Load Sysbuild board Kconfig descriptions.
osource "/opt/nordic/ncs/v3.2.2/zephyr/boards/seeed/xiao_ble/Kconfig.sysbuild"
```
